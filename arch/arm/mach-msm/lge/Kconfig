## arch/arm/mach-msm/lge/Kconfig
```kconfig
config MACH_LGE
	bool

menu "LGE Board Selection"
source "arch/arm/mach-msm/lge/Kconfig.board"
endmenu


menu "LGE Specific Patches"

config LGE_QFPROM_INTERFACE
	bool "Support qfprom interface"
	default n
	depends on MACH_LGE
	help
	  LGE QFPROM DRIVER.

config UPDATE_LCDC_LUT
	bool "Set initial Qualcomm LCDC lut"
	default n
	depends on MACH_LGE
	help
	  Set initial Qualcomm LCDC Look Up Table.

config LCD_KCAL
	bool "Interface to calibrate LCD color temperature"
	default n
	depends on MACH_LGE && UPDATE_LCDC_LUT
	help
	  Interface to calibrate LCD color temperature

config EARJACK_DEBUGGER
	bool "Earjack UART debugger support"
	depends on MACH_APQ8064_MAKO
	default n
	help
	  Saying Y here will support earjack type UART debugger cable

config LGE_CRASH_HANDLER
	tristate "Support LGE Crash Handler"
	depends on !S390 && !UML && HAVE_MEMBLOCK && MSM_DLOAD_MODE
	select ANDROID_PERSISTENT_RAM
	default n
	help
	  LGE Crash Handler

config LGE_SUSPEND_TIME
    tristate "Log time spent in suspend"
    default y
    depends on MACH_LGE
	help
	  Prints the time spent in suspend in the kernel log, and
	  keeps statistics on the time spent in suspend in
	  /sys/kernel/debug/suspend_time

	  This patch serves same function with google's suspend_time.c

config LGE_EARLYSUSPEND_FUNC_TIME
    tristate "Log time spent in each earlysuspend call"
    default y
    depends on MACH_LGE
	help
	  Keeps the time statistics spent in each earlysuspend in
	  /sys/kernel/debug/earlysuspend_func_time.
	  This file shows the average and max tiem of each
	  earlysuspend/lateresume function.

config LGE_KCAL_QLUT
     bool "Interface to calibrate LCD color temperature by QLUT"
         default n
         depends on MACH_LGE && UPDATE_LCDC_LUT && LCD_KCAL
         help
                Interface to calibrate LCD color temperature by QLUT

config LGE_LASTLBA_BACKUPGPT
	bool "Force to find Backup GPT at LAST LBA"
	depends on EFI_PARTITION
	help
	  Say Y here if you would like to make kernel always find Backup GPT
	  at Last LBA.

config LGE_BOOT_TIME_CHECK
	tristate "Support LGE BOOT TIME CHECK"
	default y
	depends on MACH_LGE
	help
	LGE SBL1 to LK BOOT TIME CHECKER.

config LGE_ECO_MODE
    tristate "Support LGE ECO Mode"
    default n
    depends on MACH_LGE
    help
      LGE ECO mode support

config LGE_LOG_SERVICE
    tristate "Support LGE Log service"
    default n
    depends on MACH_LGE
    help
      Support LGE Log Service. The author of this patch is cs77.ha@lge.com

endmenu
```

## arch/arm/mach-msm/lge/Kconfig.board
```kconfig
#
# Inlcude the specific Kconfig file for LGE board
#
# MAKO
source "arch/arm/mach-msm/lge/mako/Kconfig"

# J1V
source "arch/arm/mach-msm/lge/j1/Kconfig"

config MACH_LGE_DUMMY
	bool "NONE (No device)"
```

## drivers/nfc/Kconfig
```kconfig
#
# Near Field Communication (NFC) devices
#

menu "Near Field Communication (NFC) devices"
	depends on NFC

config LGE_NFC_PN544
	tristate "PN544 NFC driver"
	depends on I2C
	select CRC_CCITT
	default n
	---help---
	  Say yes if you want PN544 Near Field Communication driver.
	  This is for i2c connected version. If unsure, say N here.

	  To compile this driver as a module, choose m here. The module will
	  be called pn544.

config NFC_PN533
	tristate "NXP PN533 USB driver"
	depends on USB
	help
	  NXP PN533 USB driver.
	  This driver provides support for NFC NXP PN533 devices.

	  Say Y here to compile support for PN533 devices into the
	  kernel or say M to compile it as module (pn533).

config LGE_NFC_PN544_C2
	tristate "PN544 C2 NFC driver"
	depends on I2C
	select CRC_CCITT
	default n
	---help---
	  Say yes if you want PN544 Near Field Communication driver.
	  This is for i2c connected version. If unsure, say N here.

	  To compile this driver as a module, choose m here. The module will
	  be called pn544.

config LGE_NFC_PN544_C3
	tristate "PN544 C3 NFC driver"
	depends on I2C
	select CRC_CCITT
	default n
	---help---
	  Say yes if you want PN544 Near Field Communication driver.
	  This is for i2c connected version. If unsure, say N here.

	  To compile this driver as a module, choose m here. The module will
	  be called pn544.

config LGE_NFC_PRESTANDBY
	bool "NFC STANBY MODE"
	default n
	---help---
	  Say yes if you want to change a power state of pn544 to stanby mode in Kernel.
	  If unsure, say N here.

config LGE_NFC_SONY_CXD2235AGG
	bool "CXD2235AGG NFC driver"
	#depends on I2C && UART
	default n
	---help---
	  Say yes if you want CDX2235AGG Near Field Communication driver.
	  This is for i2c & UART connected version. If unsure, say N here.

	  To compile this driver as a module, choose m here. The module will
	  be called CDX2235AGG.	

source "drivers/nfc/snfc/Kconfig"

config NFC_WILINK
	tristate "Texas Instruments NFC WiLink driver"
	depends on TI_ST && NFC_NCI
	help
	  This enables the NFC driver for Texas Instrument's BT/FM/GPS/NFC
	  combo devices. This makes use of shared transport line discipline
	  core driver to communicate with the NFC core of the combo chip.

	  Say Y here to compile support for Texas Instrument's NFC WiLink driver
	  into the kernel or say M to compile it as module.

endmenu

config BCM2079X
	bool "Broadcom 2079X NFC Controller Driver"
	depends on I2C
	select CRC_CCITT
	help
	  Broadcom 2079X Near Field Communication controller support.
```
